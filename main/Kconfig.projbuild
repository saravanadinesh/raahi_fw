## main/Kconfig.projbuild
```kconfig
menu "Example Configuration"
                
    choice EXAMPLE_MODEM_DEVICE
        prompt "Choose supported modem device (DCE)"
        default EXAMPLE_MODEM_DEVICE_BG96
        help
            Select modem device connected to the ESP DTE.
        config EXAMPLE_MODEM_DEVICE_SIM800
            bool "SIM800"
            help
                SIMCom SIM800L is a GSM/GPRS module.
                It supports Quad-band 850/900/1800/1900MHz.
        config EXAMPLE_MODEM_DEVICE_BG96
            bool "BG96"
            help
                Quectel BG96 is a series of LTE Cat M1/Cat NB1/EGPRS module.
    endchoice

    config EXAMPLE_MODEM_APN
        string "Set Access Point Name (APN)"
        default "CMNET"
        help
            Logical name which is used to select the GGSN or the external packet data network.

    config EXAMPLE_MODEM_PPP_AUTH_USERNAME
        string "Set username for PPP authentication"
        default "espressif"
        help
            Set username for PPP Authentication.

    config EXAMPLE_MODEM_PPP_AUTH_PASSWORD
        string "Set password for PPP authentication"
        default "esp32"
        help
            Set password for PPP Authentication.

    config MONITOR_PHONE_NUMBER
        string "Monitor Phone Number (with area code)"
        default "+917588248846"
        help
            Enter the monitoring phone number that you want to send message to. 

    config OTA_HEADER_URL
        string "URL in which OTA header is expected to be present"
        default "https://download.bodhileaf.io:443/header.bin"
        help
            Enter URL with port number and the header file name
            
    menu "MODEM UART Configuration"
        config EXAMPLE_UART_MODEM_TX_PIN
            int "TXD Pin Number"
            default 25
            range 0 31
            help
                Pin number of UART TX.

        config EXAMPLE_UART_MODEM_RX_PIN
            int "RXD Pin Number"
            default 26
            range 0 31
            help
                Pin number of UART RX.

        config EXAMPLE_UART_MODEM_RTS_PIN
            int "RTS Pin Number"
            default 27
            range 0 31
            help
                Pin number of UART RTS.

        config EXAMPLE_UART_MODEM_CTS_PIN
            int "CTS Pin Number"
            default 23
            range 0 31
            help
                Pin number of UART CTS.

        config EXAMPLE_UART_EVENT_TASK_STACK_SIZE
            int "UART Event Task Stack Size"
            range 2000 6000
            default 2048
            help
                Stack size of UART event task.

        config EXAMPLE_UART_EVENT_TASK_PRIORITY
            int "UART Event Task Priority"
            range 3 22
            default 5
            help
                Priority of UART event task.

        config EXAMPLE_UART_EVENT_QUEUE_SIZE
            int "UART Event Queue Size"
            range 10 40
            default 30
            help
                Length of UART event queue.

        config EXAMPLE_UART_PATTERN_QUEUE_SIZE
            int "UART Pattern Queue Size"
            range 10 40
            default 20
            help
                Length of UART pattern queue.

        config EXAMPLE_UART_TX_BUFFER_SIZE
            int "UART TX Buffer Size"
            range 256 2048
            default 512
            help
                Buffer size of UART TX buffer.

        config EXAMPLE_UART_RX_BUFFER_SIZE
            int "UART RX Buffer Size"
            range 256 2048
            default 1024
            help
                Buffer size of UART RX buffer.
    endmenu

	menu "Modbus Default Configuration"
		config FIRST_SLAVE_ID
			int "Modbus first slave ID"
			range 0 255
			default 10
			help
				Slave ID of first Modbus slave.

		config SECOND_SLAVE_ID
			int "Modbus second slave ID"
			range 0 255
			default 11
			help
				Slave ID of second Modbus slave.

		config FIRST_REG
			int "First register to read"
			range 0 65535
			default 214
			help
				First register to read

		config SECOND_REG
			int "Second register to read"
			range 0 65535
			default 215
			help
				Second register to read

		config THIRD_REG
			int "Third modbus register to read"
			range 0 65535
			default 212
			help
				Third register to read
		
		config SAMPLING_PERIOD
			int "Sampling period in seconds"
			range 0 600
			default 15
			help	
				The time between two sample sets of sensor data 
	endmenu	

	menu "I2C Master"
	    config I2C_MASTER_SCL
	    int "SCL GPIO Num"
	    default 19
	    help
	        GPIO number for I2C Master clock line.
	
	config I2C_MASTER_SDA
	    int "SDA GPIO Num"
	    default 18
	    help
	        GPIO number for I2C Master data line.
	
	config I2C_MASTER_PORT_NUM
	    int "Port Number"
	    default 1
	    help
	        Port number for I2C Master device.
	
	config I2C_MASTER_FREQUENCY
	    int "Master Frequency"
	    default 100000
	    help
	        I2C Speed of Master device.
	endmenu

	menu "ADC Configuration"
		config RESISTIVE_DIVIDER
			int "Divider resistor for resistive sensors"
			range 0 20000
			default 1000
			help
				Divider resistor value in ohms

		config DIRECT_VOLTAGE_DIVIDER_RESISTOR
			int "Divider resistor for voltage sensors"
			range 0 20000
			default 1000
			help
				Divider resistor value in ohms

		config DIRECT_VOLTAGE_RECEIVER_RESISTOR
			int "Receiver resistor for voltage sensors"
			range 1 20000
			default 100
			help
				Receiver resistor value in ohms
		
		config CURRENT_LOOP_RECEIVER_RESISTOR
			int "Receiver resistor for 4-20mA sensors"
			range 1 20000
			default 100
			help
				Receiver resistor value in ohms

	endmenu

    config WIFI_SSID
        string "WiFi SSID"
        default "myssid"
        help
            SSID (network name) for the example to connect to.

    config WIFI_PASSWORD
        string "WiFi Password"
        default "mypassword"
        help
            WiFi password (WPA or WPA2) for the example to use.

            Can be left blank if the network has no security set.

	config MQTT_TOPIC_ROOT
		string "MQTT Topic Root"
		default "Sapcon"
		help
			A string without slashes that will be used as head topic

    choice EXAMPLE_CERT_SOURCE
        prompt "AWS IoT Certificate Source"
        default EXAMPLE_EMBEDDED_CERTS
        help
            AWS IoT requires loading of a device-specific certificate and private key,
            and a common Root CA Certificate. These can be compiled into the example
            app, or they can be loaded via the filesystem from an SD card.

        config EXAMPLE_EMBEDDED_CERTS
            bool "Embed into app"
        config EXAMPLE_SDCARD_CERTS
            bool "Load from SD card"
            select EXAMPLE_FILESYSTEM_CERTS
    endchoice

    # Currently this is equivalent to EXAMPLE_SDCARD_CERTS,
    # however eventually we want to support more filesystem
    # sources (SPIFFS, etc.) So this hidden config item
    # is selected whenever the item should load from filesystem.
    config EXAMPLE_FILESYSTEM_CERTS
        bool

    config EXAMPLE_CERTIFICATE_PATH
        string "Device Certificate Path"
        depends on EXAMPLE_FILESYSTEM_CERTS
        default "/sdcard/certificate.pem.crt"

    config EXAMPLE_PRIVATE_KEY_PATH
        string "Device Private Key Path"
        depends on EXAMPLE_FILESYSTEM_CERTS
        default "/sdcard/private.pem.key"

    config EXAMPLE_ROOT_CA_PATH
        string "Root CA Certificate Path"
        depends on EXAMPLE_FILESYSTEM_CERTS
        default "/sdcard/aws-root-ca.pem"

endmenu
```

## sdkconfig.defaults
```kconfig
# Enable FATFS read only with long filename support
# for loading Cert/CA/etc from filesystem
# (if enabled in config)
CONFIG_FATFS_READONLY=y
CONFIG_FATFS_CODEPAGE_437=y
CONFIG_FATFS_LFN_HEAP=y
CONFIG_PPP_SUPPORT=y
CONFIG_PPP_NOTIFY_PHASE_SUPPORT=y
CONFIG_PPP_PAP_SUPPORT=y
CONFIG_TCPIP_TASK_STACK_SIZE=4096
~                                      
# Enable TLS asymmetric in/out content length
CONFIG_MBEDTLS_ASYMMETRIC_CONTENT_LEN=y
```
